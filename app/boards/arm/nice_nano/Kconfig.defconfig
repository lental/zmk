## app/boards/arm/nice_nano/Kconfig.defconfig
```kconfig
# Copyright (c) 2021 The ZMK Contributors
# SPDX-License-Identifier: MIT

if BOARD_NICE_NANO || BOARD_NICE_NANO_V2

config BOARD
	default "Tree.len()"

config ZMK_KEYBOARD_NAME
	default "Tree.len()"

if USB_DEVICE_STACK

config USB_NRFX
    default y

endif # USB_DEVICE_STACK

config BT_CTLR
    default BT

config ZMK_SPLIT
	default y

config ZMK_SPLIT_ROLE_CENTRAL
	default y

config ZMK_BLE_SPLIT_CENTRAL_BROADCAST_HID
  default y

config  ZMK_STUDIO
	default y

endif # BOARD_NICE_NANO || BOARD_NICE_NANO_V2
```

## app/boards/arm/nice_nano/nice_nano_v2_defconfig
```kconfig
# SPDX-License-Identifier: MIT

CONFIG_SOC_SERIES_NRF52X=y
CONFIG_SOC_NRF52840_QIAA=y
CONFIG_BOARD_NICE_NANO_V2=y

# Enable MPU
CONFIG_ARM_MPU=y

# Uncomment to enable encoder, but doesn't work over BLE
# CONFIG_EC11=y
# CONFIG_EC11_TRIGGER_GLOBAL_THREAD=y

# Use pinctrl
CONFIG_PINCTRL=y

# enable GPIO
CONFIG_GPIO=y

CONFIG_USE_DT_CODE_PARTITION=y
CONFIG_BUILD_OUTPUT_UF2=y

CONFIG_MPU_ALLOW_FLASH_WRITE=y
CONFIG_NVS=y
CONFIG_SETTINGS_NVS=y
CONFIG_FLASH=y
CONFIG_FLASH_PAGE_LAYOUT=y
CONFIG_FLASH_MAP=y

CONFIG_ZMK_KSCAN_DIRECT_POLLING=y	
CONFIG_ZMK_BLE=y
CONFIG_ZMK_USB=y 
CONFIG_ZMK_SPLIT_BLE_CENTRAL_PERIPHERALS=3 # don't know why 3, but 1 more than we need

CONFIG_BT=y
CONFIG_BT_SMP_ALLOW_UNAUTH_OVERWRITE=y
CONFIG_BT_DEBUG_LOG=y
CONFIG_BT_SMP=y
CONFIG_BT_SIGNING=y
CONFIG_BT_DIS=y

# constant reflashing makes BLE keys/bonds confusing. play it safe and always clear
CONFIG_ZMK_BLE_CLEAR_BONDS_ON_START=y
```

## app/boards/arm/nrf52dk_nrf52832/Kconfig.board
```kconfig
# nRF5
config BOARD_NRF52DK_NRF52832
	bool "nRF52 DK NRF52832"
	depends on SOC_NRF52832_QFAA
```

## app/boards/arm/nrf52dk_nrf52832/Kconfig.defconfig
```kconfig
# nRF52 DK NRF52832 board configuration

config BOARD
	default "shared"

config BT_CTLR
default BT

config ZMK_BLE
	default y

config ZMK_BLE_CLEAR_BONDS_ON_START
	default y


# If we want to do bluetooth with direct HID From the keyboards, we can enable this
if NRF52_CENTRAL

config ZMK_KEYBOARD_NAME
 	default "nrf52 DK"
 
config ZMK_SPLIT_ROLE_CENTRAL
 	default y

endif

if NRF52_LEFT || NRF52_RIGHT || NRF52_CENTRAL

config ZMK_SPLIT
	default y

endif
```

## app/boards/arm/tree/Kconfig
```kconfig
# nRF52833 DK NRF52832 board configuration


config BOARD_ENABLE_DCDC
	bool "DCDC mode"
	select SOC_DCDC_NRF52X
	default y
	depends on BOARD_TREE
```

## app/boards/arm/tree/Kconfig.board
```kconfig
# nRF52833 DK NRF52832 board configuration
config BOARD_TREE
	bool "tree"
	depends on SOC_NRF52832_QFAA
```

## app/boards/arm/tree/Kconfig.defconfig
```kconfig
# nRF52833 DK NRF52833 board configuration

config BOARD
	default "Tree.len()"

config ZMK_KEYBOARD_NAME
	default "Tree.len()"

config BT_CTLR
default BT

config ZMK_BLE
	default y

# If we want to do bluetooth with direct HID From the keyboards, we can enable this
if TREE_CENTRAL

config ZMK_KEYBOARD_NAME
 	default "Tree.len() Cent"
 
config ZMK_SPLIT_ROLE_CENTRAL
 	default y

endif

if TREE_LEFT || TREE_RIGHT || TREE_CENTRAL

config ZMK_SPLIT
	default y

endif
```

## app/boards/arm/tree/tree_defconfig
```kconfig
# SPDX-License-Identifier: Apache-2.0

CONFIG_SOC_SERIES_NRF52X=y
CONFIG_SOC_NRF52832_QFAA=y
CONFIG_BOARD_TREE=y

CONFIG_MPU_ALLOW_FLASH_WRITE=y
CONFIG_NVS=y
CONFIG_SETTINGS_NVS=y
CONFIG_FLASH=y
CONFIG_FLASH_PAGE_LAYOUT=y
CONFIG_FLASH_MAP=y

CONFIG_CLOCK_CONTROL=y
CONFIG_CLOCK_CONTROL_NRF=y
CONFIG_CLOCK_CONTROL_NRF_K32SRC_RC=y

# Enable MPU
CONFIG_ARM_MPU=y

# Enable hardware stack protection
CONFIG_HW_STACK_PROTECTION=y

# enable GPIO
CONFIG_GPIO=y

# P09 and P10 to be gpio
CONFIG_NFCT_PINS_AS_GPIOS=y


CONFIG_EC11=y
CONFIG_EC11_TRIGGER_GLOBAL_THREAD=y

CONFIG_BT_KEYS_OVERWRITE_OLDEST=y
CONFIG_BT_SETTINGS=y
CONFIG_SETTINGS=y

CONFIG_SYSTEM_WORKQUEUE_STACK_SIZE=2048
CONFIG_MAIN_STACK_SIZE=2048
CONFIG_ISR_STACK_SIZE=2048

CONFIG_BT=y
CONFIG_ZMK_BLE=y
CONFIG_BT_PERIPHERAL=y
CONFIG_BT_SMP=y
CONFIG_BT_SIGNING=y
CONFIG_BT_DIS=y	

# I had to disable DCDC. When it was enabled, the keyboards wouldn't start unless debugging was enabled
CONFIG_BOARD_ENABLE_DCDC=n

# constant reflashing makes BLE keys/bonds confusing. play it safe and always clear
# CONFIG_ZMK_BLE_CLEAR_BONDS_ON_START=y
```

## app/boards/shields/nrf52dk_nrf52832/Kconfig.shield
```kconfig
config NRF52_LEFT
	def_bool $(shields_list_contains,nrf52_left)

config NRF52_RIGHT
	def_bool $(shields_list_contains,nrf52_right)


config NRF52_CENTRAL
	def_bool $(shields_list_contains,nrf52_central)
```

## app/boards/shields/tree/Kconfig.defconfig
```kconfig
if TREE_CENTRAL_NANO

config ZMK_KEYBOARD_NAME
	default "Tree.len()"

config ZMK_SPLIT
	default y

config ZMK_SPLIT_ROLE_CENTRAL
	default y

config ZMK_BLE_SPLIT_CENTRAL_BROADCAST_HID
  default y

config  ZMK_STUDIO
	default y

config  ZMK_SPLIT_BLE_CENTRAL_PERIPHERALS
  default 3

endif
```

## app/boards/shields/tree/Kconfig.shield
```kconfig
config TREE_LEFT
	def_bool $(shields_list_contains,tree_left)

config TREE_RIGHT
	def_bool $(shields_list_contains,tree_right)

config TREE_CENTRAL
	def_bool $(shields_list_contains,tree_central)

config TREE_CENTRAL_NANO
	def_bool $(shields_list_contains,tree_central_nano)
	select ZMK_BLE_CLEAR_BONDS_ON_START
	select ZMK_SPLIT_ROLE_CENTRAL
	select ZMK_KSCAN_DIRECT_POLLING
	select ZMK_BLE_SPLIT_CENTRAL_BROADCAST_HID
	select ZMK_STUDIO
	select BT
	select BT_SMP_ALLOW_UNAUTH_OVERWRITE
	select BT_SMP
	select BT_SIGNING
	select BT_DIS
```
